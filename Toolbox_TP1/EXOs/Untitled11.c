void main()
{
  int i;
  int j;
  RCC->AHBENR |=(1<<1);
  GPIOB->MODER |=(1<<2);
  //GPIOB->MODER &=~(1<<3);
  GPIOB->OTYPER &=~(1<<1);
  GPIOB->OSPEEDR &=~((1<<2)|(1<<3));
  GPIOB->ODR &=~(1<<1);
  
  GPIOB->MODER |=((1<<4)|(1<<20)|(1<<22)|(1<<24)|(1<<26)|(1<<28)|(1<<30));   //l1 pb2 l2 pb10
  GPIOB->OTYPER &=~((1<<2)|(1<<10)|(1<<11)|(1<<12)|(1<<13)|(1<<14)|(1<<15));//conf en push pull
  GPIOB->OSPEEDR &=~((1<<4)|(1<<5)|(1<<20)|(1<<21)|(1<<22)|(1<<23)|(1<<24)|(1<<25)|(1<<26)|(1<<27)|(1<<28)|(1<<29)|(1<<30)|(1<<31));
  GPIOB->ODR &=~((1<<2)|(1<<10)|(1<<11)|(1<<12)|(1<<13)|(1<<14)|(1<<15));
  
  
  
  
  while(1)
  {
    
    GPIOB->ODR |=(1<<1);//led1
    for(i=0;i<100000;i++){
    }
    GPIOB->ODR |=(1<<2);//led2
    for(i=0;i<100000;i++){
    }
    
    for(j=10;j<16;j++){//led 3 a 8
      for(i=0;i<100000;i++){
      }
      GPIOB->ODR |=(1<<j);
    }
    
    //___________________
    GPIOB->ODR &=~(1<<1); //led 1
    for(i=0;i<100000;i++){
    }
    GPIOB->ODR &=~(1<<2);//led 2
    for(i=0;i<100000;i++){
    }
    
    for(j=10;j<16;j++){  //led 3 a 8
      for(i=0;i<100000;i++){
      }
      GPIOB->ODR &=~(1<<j);
    }  
  } 
}